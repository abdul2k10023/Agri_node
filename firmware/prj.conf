## CMakeLists.txt
```
cmake_minimum_required(VERSION 3.28.0)
find_package(Zephyr REQUIRED HINTS $ENV{ZEPHYR_BASE})
project(moist_node LANGUAGES C)
target_sources(app PRIVATE src/main.c src/thread_demo.c)
```

## west.yml
```
manifest:
  version: "0.13"
  projects:
    - name: zephyr
      url: https://github.com/zephyrproject-rtos/zephyr
      revision: v4.4.0
      path: zephyr
      import:
        path-prefix: deps
  self:
    path: firmware
```

## prj.conf
```kconfig
CONFIG_GPIO=y
CONFIG_SERIAL=y
CONFIG_CONSOLE=y
CONFIG_UART_CONSOLE=y
CONFIG_PRINTK=y
CONFIG_UART_LINE_CTRL=y
CONFIG_USB_DEVICE_STACK_NEXT=y
CONFIG_CDC_ACM_SERIAL_INITIALIZE_AT_BOOT=y
CONFIG_CDC_ACM_SERIAL_PRODUCT_STRING="Moist Node console"

# Two identical boards automatically form/join this demonstration Thread network.
CONFIG_NETWORKING=y
CONFIG_NET_L2_OPENTHREAD=y
CONFIG_OPENTHREAD_FTD=y
CONFIG_OPENTHREAD_NETWORK_NAME="MoistNodeDemo"
CONFIG_OPENTHREAD_CHANNEL=15
CONFIG_OPENTHREAD_PANID=4660
CONFIG_OPENTHREAD_XPANID="11:11:11:11:22:22:22:22"
# Public test key; replace for a real deployment.
CONFIG_OPENTHREAD_NETWORKKEY="00:11:22:33:44:55:66:77:88:99:aa:bb:cc:dd:ee:ff"

# Reapply the demo configuration each boot instead of restoring an old network.
CONFIG_OPENTHREAD_SETTINGS_RAM=y
CONFIG_NVS=y
CONFIG_NET_IPV4=n
CONFIG_NET_TCP=n
CONFIG_MAIN_STACK_SIZE=4096
```

## src/main.c
```c
#include <errno.h>
#include <inttypes.h>
#include <zephyr/device.h>
#include <zephyr/drivers/gpio.h>
#include <zephyr/drivers/uart.h>
#include <zephyr/kernel.h>
#include <zephyr/sys/printk.h>
#include <zephyr/sys/util.h>
#include <zephyr/version.h>

#include "thread_demo.h"
#include "moisture.h"

BUILD_ASSERT(DT_NODE_HAS_COMPAT(DT_CHOSEN(zephyr_console), zephyr_cdc_acm_uart),
             "This application requires a USB CDC ACM console");

static const struct gpio_dt_spec led = GPIO_DT_SPEC_GET(DT_ALIAS(led0), gpios);

int main(void)
{
    const struct device *console = DEVICE_DT_GET(DT_CHOSEN(zephyr_console));
    bool terminal_was_open = false;
    uint32_t ticks = 0;

    if (!gpio_is_ready_dt(&led)) {
        printk("LED controller is not ready\n");
        return -ENODEV;
    }

    int err = gpio_pin_configure_dt(&led, GPIO_OUTPUT_INACTIVE);

    if (err < 0) {
        printk("LED configuration failed: %d\n", err);
        return err;
    }

    int thread_error = thread_demo_init();

    for (;;) {
        uint32_t dtr = 0;
        bool terminal_open = device_is_ready(console) &&
            uart_line_ctrl_get(console, UART_LINE_CTRL_DTR, &dtr) == 0 && dtr;

        err = gpio_pin_toggle_dt(&led);
        if (terminal_open) {
            if (!terminal_was_open) {
                printk("\nMoist Node: Zephyr %s\n", KERNEL_VERSION_STRING);
                printk("Board: %s | UF2 application | USB console ready\n",
                       CONFIG_BOARD_TARGET);
                printk("Thread demo: same firmware on both boards; UDP port 4242\n");
                if (thread_error != 0) {
                    printk("Thread demo initialization failed: %d\n", thread_error);
                }
            }
            if (ticks % 4U == 0U || !terminal_was_open) {
                printk("uptime=%" PRId64 " ms, LED=%s\n", k_uptime_get(),
                       err < 0 ? "GPIO error" : "heartbeat running");
            }
        }
        
        if (thread_error == 0) {
            thread_demo_poll(terminal_open);
        }
        terminal_was_open = terminal_open;
        ++ticks;
        k_sleep(K_MSEC(2000));
    }
}
```

## src/moisture.c
```c
#include "moisture.h"

#include <errno.h>
#include <zephyr/device.h>
#include <zephyr/drivers/gpio.h>
#include <zephyr/kernel.h>
#include <zephyr/sys/printk.h>

#define GPIO_SENSE       20
#define GPIO_CHARGE      22
#define GPIO_DISCHARGE   24

#define TIMEOUT_US    10000
#define DISCHARGE_HOLD_MS  20
static const struct device *const gpio_port = DEVICE_DT_GET(DT_NODELABEL(gpio0));


static int64_t measure_sensor_us(void)
{

    // Hold the MOS on even if SENSE already reads LOW: LOW does not
    // guarantee that the capacitor has fully discharged.
    gpio_pin_set(gpio_port, GPIO_CHARGE, 0);
    gpio_pin_set(gpio_port, GPIO_DISCHARGE, 1);
    k_msleep(DISCHARGE_HOLD_MS);

    if (gpio_pin_get(gpio_port, GPIO_SENSE) != 0)
    {
        gpio_pin_set(gpio_port, GPIO_DISCHARGE, 0);
        printk("Sensor still HIGH after discharge\n");
        return -1;
    }

    // Release the sensor node before charging it.
    gpio_pin_set(gpio_port, GPIO_DISCHARGE, 0);
    k_busy_wait(10);

    if (gpio_pin_get(gpio_port, GPIO_SENSE) != 0)
    {
        printk("Sensor became HIGH before charging\n");
        return -1;
    }

    // Start charging through 1 MΩ
    uint32_t start_cycles = k_cycle_get_32();
    gpio_pin_set(gpio_port, GPIO_CHARGE, 1);

    while (gpio_pin_get(gpio_port, GPIO_SENSE) == 0)
    {
        int64_t elapsed_us = k_cyc_to_us_floor64((uint32_t)(k_cycle_get_32() - start_cycles));

        if (elapsed_us > TIMEOUT_US)
        {
            gpio_pin_set(gpio_port, GPIO_CHARGE, 0);
            printk("Sensor did not reach HIGH within %d us\n", TIMEOUT_US);
            return -1;
        }

        // Keep microsecond timing; the short timeout bounds this busy wait.
    }

    int64_t charge_time_us = k_cyc_to_us_floor64((uint32_t)(k_cycle_get_32() - start_cycles));

    // Stop charging
    gpio_pin_set(gpio_port, GPIO_CHARGE, 0);

    return charge_time_us;
}

int ping_moisture_sensor(struct moisture_samples *samples)
{
    int result = 0;

    if (samples == NULL)
    {
        return -EINVAL;
    }

    for (int i = 0; i < MOISTURE_SAMPLE_COUNT; ++i)
    {
        samples->elapsed_us[i] = -1;
    }

    if (!device_is_ready(gpio_port))
    {
        printk("GPIO0 controller is not ready\n");
        return -ENODEV;
    }

    if (gpio_pin_configure(gpio_port, GPIO_DISCHARGE, GPIO_OUTPUT_LOW) < 0 ||
        gpio_pin_configure(gpio_port, GPIO_SENSE, GPIO_INPUT) < 0 ||
        gpio_pin_configure(gpio_port, GPIO_CHARGE, GPIO_OUTPUT_LOW) < 0)
    {
        printk("Sensor GPIO configuration failed\n");
        return -EIO;
    }

    for (int i = 0; i < MOISTURE_SAMPLE_COUNT; ++i)
    {
        samples->elapsed_us[i] = measure_sensor_us();

        if (samples->elapsed_us[i] < 0)
        {
            printk("Sensor measurement failed\n");
            result = -EIO;
        }
    }

    return result;
}
```

## src/moisture.h
```c
#ifndef MOIST_NODE_MOISTURE_H
#define MOIST_NODE_MOISTURE_H

#include <stdint.h>

#define MOISTURE_SAMPLE_COUNT 5

struct moisture_samples {
    /* Raw charge times in microseconds; -1 marks a failed measurement. */
    int64_t elapsed_us[MOISTURE_SAMPLE_COUNT];
};

/* Collect one batch. Returns 0 on success, or a negative error code.
 * On measurement failure, all five are still attempted and results retained.
 * Sleeps during each discharge; call from a thread, not an interrupt.
 */
int ping_moisture_sensor(struct moisture_samples *samples);

#endif
```

## src/thread_demo.c
```c
#include "thread_demo.h"

#include <errno.h>
#include <inttypes.h>
#include <string.h>

#include <openthread.h>
#include <openthread/ip6.h>
#include <openthread/link.h>
#include <openthread/thread.h>
#include <openthread/udp.h>
#include <zephyr/kernel.h>
#include <zephyr/sys/atomic.h>
#include <zephyr/sys/printk.h>

#define DEMO_PORT 4242
#define DEMO_INTERVAL_MS 6000
#define DEMO_PAYLOAD_SIZE 80

struct received_message {
    otIp6Address peer;
    char text[DEMO_PAYLOAD_SIZE];
};

K_MSGQ_DEFINE(receive_queue, sizeof(struct received_message), 8, 4);

static otInstance *instance;
static otUdpSocket socket;
static otIp6Address destination;
static char node_id[17];
static atomic_t receive_count;
static atomic_t dropped_count;
static uint32_t sequence;
static uint32_t transmit_count;
static uint32_t transmit_errors;
static int64_t next_send;
static int64_t next_status;
static otDeviceRole previous_role = OT_DEVICE_ROLE_DISABLED;
static bool terminal_was_open;

/* Runs in OpenThread's context: copy data, then let main() print it later. */
static void receive_message(void *context, otMessage *message, const otMessageInfo *info)
{
    struct received_message received = { .peer = info->mPeerAddr };
    uint16_t offset = otMessageGetOffset(message);
    uint16_t length = otMessageGetLength(message) - offset;

    ARG_UNUSED(context);
    if (length == 0 || length >= sizeof(received.text)) {
        atomic_inc(&dropped_count);
        return;
    }
    if (otMessageRead(message, offset, received.text, length) != length) {
        atomic_inc(&dropped_count);
        return;
    }
    /* Ignore a local multicast copy if the stack ever delivers one. */
    if (length >= 17 && strncmp(received.text, node_id, 16) == 0 &&
        received.text[16] == ' ') {
        return;
    }
    if (k_msgq_put(&receive_queue, &received, K_NO_WAIT) != 0) {
        atomic_inc(&dropped_count);
        return;
    }
    atomic_inc(&receive_count);
}

int thread_demo_init(void)
{
    otSockAddr local = { .mPort = DEMO_PORT };
    otError error;

    instance = openthread_get_default_instance();
    if (instance == NULL) {
        return -ENODEV;
    }

    openthread_mutex_lock();
    const otExtAddress *address = otLinkGetExtendedAddress(instance);

    for (size_t i = 0; i < sizeof(address->m8); ++i) {
        snprintk(&node_id[i * 2], 3, "%02x", address->m8[i]);
    }
    error = otIp6AddressFromString("ff03::1", &destination);
    if (error == OT_ERROR_NONE) {
        error = otUdpOpen(instance, &socket, receive_message, NULL);
    }
    if (error == OT_ERROR_NONE) {
        error = otUdpBind(instance, &socket, &local, OT_NETIF_THREAD_INTERNAL);
        if (error != OT_ERROR_NONE) {
            (void)otUdpClose(instance, &socket);
        }
    }
    openthread_mutex_unlock();
    return error == OT_ERROR_NONE ? 0 : -EIO;
}

/* Caller holds OpenThread's mutex. Success means queued, not delivered. */
static otError send_message(void)
{
    char payload[DEMO_PAYLOAD_SIZE];
    otMessageInfo info = {
        .mPeerAddr = destination,
        .mPeerPort = DEMO_PORT,
        .mHopLimit = 64,
    };
    otMessage *message = otUdpNewMessage(instance, NULL);
    otError error;

    if (message == NULL) {
        return OT_ERROR_NO_BUFS;
    }
    int length = snprintk(payload, sizeof(payload), "%s seq=%" PRIu32 " hello",
                         node_id, ++sequence);

    error = otMessageAppend(message, payload, length);
    if (error == OT_ERROR_NONE) {
        error = otUdpSend(instance, &socket, message, &info);
    }
    if (error != OT_ERROR_NONE) {
        otMessageFree(message);
    }
    return error;
}

void thread_demo_poll(bool terminal_open)
{
    struct received_message received;
    otIp6Address local_address;
    otDeviceRole role;
    otError send_error = OT_ERROR_NONE;
    int64_t now = k_uptime_get();
    bool attempted_send = false;
    char address_text[OT_IP6_ADDRESS_STRING_SIZE];

    openthread_mutex_lock();
    role = otThreadGetDeviceRole(instance);
    local_address = *otThreadGetMeshLocalEid(instance);
    bool attached = role == OT_DEVICE_ROLE_CHILD || role == OT_DEVICE_ROLE_ROUTER ||
                    role == OT_DEVICE_ROLE_LEADER;

    if (attached && now >= next_send) {
        attempted_send = true;
        send_error = send_message();
        next_send = now + DEMO_INTERVAL_MS;
    }
    openthread_mutex_unlock();

    if (attempted_send) {
        if (send_error == OT_ERROR_NONE) {
            ++transmit_count;
        } else {
            ++transmit_errors;
        }
        if (terminal_open) {
            printk("Thread TX seq=%" PRIu32 " %s (error=%d)\n", sequence,
                   send_error == OT_ERROR_NONE ? "queued" : "failed", send_error);
        }
    }

    while (k_msgq_get(&receive_queue, &received, K_NO_WAIT) == 0) {
        if (terminal_open) {
            otIp6AddressToString(&received.peer, address_text, sizeof(address_text));
            printk("Thread RX from %s: %s\n", address_text, received.text);
        }
    }

    if (terminal_open && (!terminal_was_open || role != previous_role || now >= next_status)) {
        otIp6AddressToString(&local_address, address_text, sizeof(address_text));
        printk("Thread node=%s role=%s address=%s\n", node_id,
               otThreadDeviceRoleToString(role), address_text);
        printk("Thread totals: TX=%" PRIu32 " RX=%ld errors=%" PRIu32 " dropped=%ld\n",
               transmit_count, (long)atomic_get(&receive_count), transmit_errors,
               (long)atomic_get(&dropped_count));
        next_status = now + DEMO_INTERVAL_MS;
    }
    previous_role = role;
    terminal_was_open = terminal_open;
}
```

## src/thread_demo.h
```c
#ifndef MOIST_NODE_THREAD_DEMO_H
#define MOIST_NODE_THREAD_DEMO_H

#include <stdbool.h>

int thread_demo_init(void);
void thread_demo_poll(bool terminal_open);

#endif
```
